## conf/layer.conf
```bitbake
# We have a conf and classes directory, add to BBPATH
BBPATH .= ":${LAYERDIR}"

# We have recipes-* directories, add to BBFILES
BBFILES += "${LAYERDIR}/recipes-*/*/*.bb \
            ${LAYERDIR}/recipes-*/*/*.bbappend"

BBFILE_COLLECTIONS += "meta-licheepiDockAdb"
BBFILE_PATTERN_meta-licheepiDockAdb = "^${LAYERDIR}/"
BBFILE_PRIORITY_meta-licheepiDockAdb = "6"

LAYERDEPENDS_meta-licheepiDockAdb = "core"
LAYERSERIES_COMPAT_meta-licheepiDockAdb = "kirkstone"
```
